## boards/shields/pocketboard/Kconfig.defconfig
```kconfig
if SHIELD_POCKETBOARD_LEFT

config ZMK_KEYBOARD_NAME
    default "PocketBoard"

endif
```

## boards/shields/pocketboard/Kconfig.shield
```kconfig
config SHIELD_POCKETBOARD_LEFT
    def_bool $(shields_list_contains,pocketboard_left)

config SHIELD_POCKETBOARD_RIGHT
    def_bool $(shields_list_contains,pocketboard_right)
```
